## ddos_np/np/mcore/fpn-6wind/configs/fp_defconfig
```kconfig
# CONFIG_MCORE_KTABLES is not set
# CONFIG_MCORE_FPMONITORD is not set
# CONFIG_MCORE_RFPVI is not set
# CONFIG_MCORE_FPM_NFCT is not set

# CONFIG_MCORE_SDSIFD is not set
# CONFIG_MCORE_EMBEDDED_SCRIPTS is not set
```

## ddos_np/np/mcore/fpn-6wind/configs/tgen_defconfig
```kconfig
# Usual unset options
#
# CONFIG_MCORE_KTABLES is not set
# CONFIG_MCORE_FPMONITORD is not set
# CONFIG_MCORE_RFPVI is not set
# CONFIG_MCORE_FPM_NFCT is not set
# CONFIG_MCORE_SDSIFD is not set
# CONFIG_MCORE_EMBEDDED_SCRIPTS is not set
#
# Not used by tgen
#
# CONFIG_MCORE_M_TAG is not set
# CONFIG_MCORE_SDSIFD is not set
# CONFIG_MCORE_HITFLAGS_SYNC is not set
# CONFIG_MCORE_TC is not set
# CONFIG_MCORE_RFPVI is not set
# CONFIG_MCORE_FPTUN is not set
# CONFIG_MCORE_FPS is not set
# CONFIG_MCORE_FPM is not set
#
# It is off by default
CONFIG_MCORE_TRAFFIC_GEN=y
```
